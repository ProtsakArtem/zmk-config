## config/boards/shields/corne_hw_right/Kconfig.defconfig
```kconfig
config ZMK_SPLIT
	def_bool y

config ZMK_SPLIT_BLE
	def_bool y

config ZMK_SPLIT_ROLE_PERIPHERAL
	def_bool y

# Peripheral half should NOT default to USB
config ZMK_USB
	def_bool n
```
